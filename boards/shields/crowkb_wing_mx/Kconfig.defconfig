## boards/shields/crowkb_wing_mx/Kconfig.defconfig
```kconfig
if SHIELD_CROWKB_WING_MX

config ZMK_KEYBOARD_NAME
    default "crowkb_wing_mx"

endif # SHIELD_CROWKB_WING_MX
```

## boards/shields/crowkb_wing_mx/Kconfig.shield
```kconfig
config SHIELD_CROWKB_WING_MX
    def_bool $(shields_list_contains,crowkb_wing_mx)
```
